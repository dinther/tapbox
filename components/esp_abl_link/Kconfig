## components/esp_abl_link/Kconfig
```kconfig
menu "Ableton Link"

    config LINK_ESP_TASK_CORE_ID
        int "Link task core affinity"
        depends on !FREERTOS_UNICORE
        range -1 1
        default -1
        help
            Select which CPU core to run Link tasks on.

            -1: No affinity (tskNO_AFFINITY) - FreeRTOS schedules on any core
             0: Core 0 - Note that WiFi also runs on core 0, which may cause contention
             1: Core 1 - Recommended to avoid contention with WiFi

            This option is only available when FREERTOS_UNICORE is not enabled.

endmenu
```

## sdkconfig.defaults
```kconfig
# Flash — WT32-ETH01 has 4 MB
CONFIG_ESPTOOLPY_FLASHSIZE_4MB=y

# Ethernet
CONFIG_ETH_ENABLED=y
CONFIG_ETH_USE_ESP32_EMAC=y
CONFIG_ETH_PHY_LAN87XX=y

# LwIP — needed for Link multicast; 16 sockets covers Link + OSC + CDJ + HTTP in AP mode
CONFIG_LWIP_IGMP=y
CONFIG_LWIP_SO_RCVBUF=y
CONFIG_LWIP_MAX_SOCKETS=16

# Auto-IP fallback: with no DHCP server on the wire (direct cable to a Denon
# player or laptop) self-assign a 169.254.x.x link-local address after the
# DHCP probes fail — same range Engine OS uses, so Link peers can meet
CONFIG_LWIP_AUTOIP=y

# C++ exceptions required by Ableton Link internals
CONFIG_COMPILER_CXX_EXCEPTIONS=y
CONFIG_COMPILER_CXX_RTTI=y
# Emergency exception pool — default 0 means a throw whose exception object
# can't be heap-allocated aborts the whole device (std::terminate). Link
# throws UdpSendException on a transient UDP send failure and catches it to
# repair the gateway; with a 0-size pool, if that throw lands while heap is
# momentarily exhausted, __cxa_allocate_exception fails and it aborts instead.
# A small reserved pool lets the exception throw and unwind normally even
# under memory pressure. (Confirmed as a real abort() path via a decoded
# crash backtrace through sendUdpMessage -> __cxa_allocate_exception.)
CONFIG_COMPILER_CXX_EXCEPTIONS_EMG_POOL_SIZE=2048

# 1 kHz tick so pdMS_TO_TICKS(1) == 1 tick (accurate button polling)
CONFIG_FREERTOS_HZ=1000

# Main task stack — Link needs headroom
CONFIG_ESP_MAIN_TASK_STACK_SIZE=16384

# OTA rollback — bootloader rolls back to previous slot if new firmware never marks itself valid
CONFIG_BOOTLOADER_APP_ROLLBACK_ENABLE=y

# OTA over HTTPS — common CA bundle (covers DigiCert/GitHub Pages, saves ~150 KB vs full)
CONFIG_MBEDTLS_CERTIFICATE_BUNDLE=y
CONFIG_MBEDTLS_CERTIFICATE_BUNDLE_DEFAULT_CMN=y

# WebSocket support for the live audio-tuning chart on the web config page
CONFIG_HTTPD_WS_SUPPORT=y
```
